#include <Arduino.h>
#include <WiFi.h>
#include <ESP32Servo.h>
#include <Wire.h>
#include <Adafruit_GFX.h>
#include <Adafruit_SSD1306.h>

static const bool ENABLE_OBSTACLE_DETECTION = true;

/* ===================== PINS / CONSTANTS ===================== */

// ---------- WIFI / SERVER ----------
static const char* WIFI_SSID     = "iot";
static const char* WIFI_PASSWORD = "temporizer36whit";

static const char* API_HOST = "3.250.38.184";
static const int   API_PORT = 8000;
static const char* TEAM_ID  = "dggb1125";

static const uint32_t WIFI_CONNECT_TIMEOUT_MS = 20000;
static const uint32_t HTTP_TIMEOUT_MS         = 10000;

// ---------- NODE LED ----------
static const int NODE_LED_PIN = 48;
static const bool NODE_LED_ACTIVE_HIGH = true;
static const uint32_t NODE_LED_ON_MS = 120;

// ---------- LINE SENSORS ----------
static const int NUM_SENSORS = 5;
static const int ANALOG_PIN[NUM_SENSORS] = {4, 5, 6, 7, 15};

// Your convention: "low = white line"
static const int LINE_THRESHOLD = 1000;

// ---------- MOTORS ----------
static const int MOTOR1_PWM   = 37; // left
static const int MOTOR1_PHASE = 38;
static const int MOTOR2_PWM   = 39; // right
static const int MOTOR2_PHASE = 20;

static const int BASE_SPEED = 210;
static const int MIN_SPEED  = 0;
static const int MAX_SPEED  = 255;

// Motor2 offset (right motor PWM bias)
static const int MOTOR2_OFFSET_PWM = 10;

// Motor mismatch (~15% faster on one side)
static const float LEFT_MOTOR_GAIN  = 1.00f;
static const float RIGHT_MOTOR_GAIN = 0.85f;

// Line following gains
static const float KP = 190.0f;
static const float KD = 45.0f;

// Reduce turning aggressiveness (helps node detection)
static const float CORRECTION_SCALE_NORMAL = 0.80f;
static const float CORRECTION_SCALE_PARK   = 0.45f;
static const float MAX_CORRECTION          = 170.0f;

// ===== Parking straight-line trim (your proven straight code) =====
// NEGATIVE slows RIGHT (fixes veering left)
static const int PARK_TRIM = -35;   // use the value that works for you

// ---------- LOOP CADENCE ----------
static const uint32_t CONTROL_TICK_MS = 5;
static const uint32_t STATUS_PRINT_MS = 2000;

// ---------- NODE DETECTION (BASE) ----------
static const uint8_t  NODE_TRIP_LOWCOUNT_STRONG = 4;
static const uint32_t NODE_DEBOUNCE_MS          = 15;
static const uint32_t NODE_REARM_MS             = 170;

// ---------- NODE 6 "RELAXED" DETECTION (ONLY when approaching node 6) ----------
static const uint8_t  NODE6_TRIP_LOWCOUNT_STRONG = 3;
static const uint8_t  NODE6_TRIP_LOWCOUNT_WEAK   = 2;
static const uint32_t NODE6_DEBOUNCE_MS          = 10;
static const bool     NODE6_ALLOW_WEAK_NO_OUTERS = true;

// ---------- TURN / MOVE TIMINGS ----------
static const uint32_t TURN_PRE_FORWARD_MS = 120;
static const uint32_t TURN_PRE_PAUSE_MS   = 30;
static const uint32_t TURN90_MS           = 300;

static const uint32_t TURN180_MS_BASE = 650;
static const float TURN180_SCALE_NORMAL = 1.00f;
static const float TURN180_SCALE_NODE6  = 0.88f;   // tune 0.85–0.92


static const uint32_t MOVE_EXIT_NODE_MS   = 220;
static const uint32_t MOVE_PAUSE_MS       = 35;
static const uint32_t MOVE_PRESTOP_MS     = 60;

// --- Parking special 180 at node 1 before going to node 6 ---
static const uint32_t PARK_NODE1_POST180_BACKOFF_MS   = 120; // tune 60–200
static const int      PARK_NODE1_POST180_BACKOFF_PWM  = 170; // tune 140–210
static const uint32_t PARK_NODE1_POST180_PAUSE_MS     = 40;




// ---------- CATCH LINE ----------
static const uint32_t CATCHLINE_TIMEOUT_MS = 675;
static const int      CATCHLINE_SPEED      = 155;
static const int      CATCHLINE_SPIN_DELTA = 120;

// ---------- ULTRASONIC ----------
static const int US_TRIG_PIN = 17;
static const int US_ECHO_PIN = 18;

static const float SOUND_SPEED_CM_PER_US = 0.0343f;
static const float US_TIMEOUT_CM = 400.0f;
static const uint32_t US_TIMEOUT_US = (uint32_t)(US_TIMEOUT_CM * 2 / SOUND_SPEED_CM_PER_US);

// STOP BEFORE WALL - Parking only
static const float WALL_STOP_DISTANCE_CM = 3.0f;
static const float WALL_SLOW_DISTANCE_CM = 15.0f;
static const float US_HARD_MIN_CM = 2.5f;

// Ultrasonic sampling
static const uint32_t US_PERIOD_MS = 25;
static const uint8_t  US_SAMPLES = 5;
static const uint8_t  US_DISCARD = 1;
static const uint16_t US_SAMPLE_GAP_US = 200;
static const float    US_EMA_ALPHA = 0.75f;

// Wall detection confidence
static const uint8_t WALL_CONFIRM_HITS   = 3;
static const uint8_t WALL_GRACE_INVALID  = 2;

// ---------- PARKING ----------
static const int CMD_START_PARK  = 5;
static const int PARK_START_NODE = 1;
static const int PARK_INTERMEDIATE_NODE = 6;

static const uint32_t PARK_TO_STRAIGHT_MS = 120;
static const uint32_t PARK_LINE_LOST_MS   = 180;

static const int PARK_BASE_SPEED      = 200;
static const int PARK_BEND_DELTA_FAST = 35;
static const int PARK_BEND_DELTA_SLOW = 60;

static const bool PARK_LINE_SIDE_REVERSED = true;

// when wall is hit, report node 5 to server
static const int PARK_WALL_HIT_NODE = 5;
// --- Node 6 extra sensitivity during parking leg 1->6 ---
static const uint32_t NODE6_DEBOUNCE_MS_NORMAL = 18;  // your existing relaxed debounce
static const uint32_t NODE6_DEBOUNCE_MS_PARK   = 8;   // extra sensitive (tune 6–12ms)

// Returns true only during parking travel from node 1 to node 6



// ---------- GRAPH ----------
static const int NUM_NODES = 7;

// ---------- ROUTE PREFERENCES ----------
static const int NODE6_PENALTY_COST   = 4;
static const int HUB_PREFERENCE_BONUS = 1;
static const int EDGE_4_TO_3_PENALTY_COST = 35;

// ---------- OBSTACLE DETECTION (NORMAL DRIVING) ----------
static const float OBSTACLE_STOP_DISTANCE_CM = 5.0f;
static const uint8_t OBSTACLE_CONFIRM_HITS   = 2;
static const uint32_t OBSTACLE_CHECK_MS      = 40;
static const float OBSTACLE_MAX_VALID_CM = 80.0f;

//sprite loop tracker
int spriteNum = 0;

/* ===================== ROUTE MATRICES ===================== */
// Movement: 1=forward, -1=180, 2=left, 3=right
static int antiClockwiseMatrix[NUM_NODES][NUM_NODES] = {
  {0,  0,  0,  0, -1,  1,  0},
  {0,  0,  0,  0,  0, -1,  1},
  {0,  0,  0,  1,  0, -1,  0},
  {0,  0, -1,  0,  0,  0,  1},
  {1,  0,  0,  0,  0,  0, -1},
  {-1, 2,  1,  0,  0,  0,  0},
  {0,  2,  0, -1,  1,  0,  0}
};
 
static int clockwiseMatrix[NUM_NODES][NUM_NODES] = {
  {0,  0,  0,  0,  1, -1,  0},
  {0,  0,  0,  0,  0,  1, -1},
  {0,  0,  0, -1,  0,  1,  0},
  {0,  0,  1,  0,  0,  0, -1},
  {-1, 0,  0,  0,  0,  0,  1},
  {1,  3, -1,  0,  0,  0,  0},
  {0,  3,  0,  1, -1,  0,  0}
};

/* ===================== GLOBALS ===================== */
WiFiClient client;

static int   analogValue[NUM_SENSORS] = {0,0,0,0,0};
static float lastError      = 0.0f;
static float lastCorrection = 0.0f;

static int path[10];
static int pathStep   = 0;
static int pathLength = 0;

static int  currentNode = -1;
static int  currentGoal = -1;
static bool clockwise   = false;
static bool navigating  = false;
static bool pathComputed= false;
static bool startingUp  = true;

static bool finishedAll     = false;
static bool reachedGoalFlag = false;

// Node detection state
static bool nodeArmed         = true;
static bool nodeStableNow     = false;
static uint32_t nodeHighSince = 0;
static uint32_t lastNodeTime  = 0;

// Expected next node (used for node-6 relaxed detection)
static int expectedNextNode = -1;

// LED pulse state
static uint32_t nodeLedOffAt = 0;
static bool nodeEventLatched = false;

// Obstacle detection state
static uint32_t lastObstacleCheckMs = 0;
static uint8_t  obstacleHitCount   = 0;
static bool     obstacleDetected   = false;

// Control cadence
static uint32_t lastControlTick = 0;

// Servo Pins
#define leftServoPin 10 // left servo control
#define rightServoPin 3 // right servo control

Servo leftServo;
Servo rightServo;

//---------Display Stuff--------------
#define SCREEN_WIDTH 128
#define SCREEN_HEIGHT 64

// Create display object (I2C)
Adafruit_SSD1306 display(SCREEN_WIDTH, SCREEN_HEIGHT, &Wire, -1);

// ESP32-S3 common I2C pins
#define SDA_PIN 8
#define SCL_PIN 9

//music shtuff
#define musicPin 14

// ---------- DYNAMIC BLOCKED EDGES (persist until reboot) ----------
static bool blockedEdge[NUM_NODES][NUM_NODES] = { false };

// Block both directions so the robot never uses that physical segment again
static inline void blockEdgeBothWays(int u, int v) {
  if (u < 0 || u >= NUM_NODES || v < 0 || v >= NUM_NODES) return;
  blockedEdge[u][v] = true;
  blockedEdge[v][u] = true;
}

static inline bool isEdgeBlocked(int u, int v) {
  if (u < 0 || u >= NUM_NODES || v < 0 || v >= NUM_NODES) return true;
  return blockedEdge[u][v];
}


// ---------- ULTRASONIC ----------
static uint32_t lastUSms = 0;
static float usEma = 0.0f;
static uint8_t wallHitCount = 0;
static uint8_t wallInvalidStreak = 0;
static bool wallConfirmed = false;
static bool ultrasonicEnabled = false;

// Parking FSM
enum ParkingStage : uint8_t {
  PARK_NONE = 0,
  PARK_GOTO_NODE1,
  PARK_GOTO_NODE6,
  PARK_DRIVE_STRAIGHT_TO_WALL,
  PARK_STRAIGHT_ON_LINE,
  PARK_UNTIL_LINE_LOST,
  PARK_BEND_AWAY_IF_LINE_REAPPEARS,
  PARK_STOPPED
};

static ParkingStage parkingStage = PARK_NONE;

static uint32_t parkStraightStartMs = 0;
static uint32_t lineLostSinceMs = 0;

static bool parkingWallReported = false;

static inline bool node6ExtraSensitiveActive() {
  return (parkingStage == PARK_GOTO_NODE6) && (currentGoal == PARK_INTERMEDIATE_NODE); // goal==6
}

/* ===================== FORWARD DECLS ===================== */
void connectToWiFi(uint32_t timeoutMs = WIFI_CONNECT_TIMEOUT_MS);
bool ensureWiFi();
bool httpConnect();
void httpStop();
String readHTTPResponse();
String extractBody(const String& response);
String apiPostArrived(int position);
bool isFinishedMessage(String s);

void ReadSensorsFast();
uint8_t countLowSensors();
bool isLinePresent();
int  lineMinIndex();
bool isNodeNowFast();
void updateNodeDetector();

void SetMotors(int leftSpeed, int rightSpeed);
void motorStop();

void turn180();
void turn90Left();
void turn90Right();

void catchLineAfterTurn(int biasDir);
void lineFollowing(bool straightBias);

bool dijkstraPathfinding(int startIdx, int endIdx);
void navigateToTarget(int targetNode);
void executeMovement(int movementType, int nextNode);
int  movementForEdge(int from, int to);

void handleStartup();
void handleNodeArrival();
void printCurrentStatus();

// ultrasonic
void enableUltrasonic();
void disableUltrasonic();
float ultrasonicMeasureOnceCm();
float ultrasonicFilteredCm(bool forceSample);
void  wallDetectUpdate(float cmFiltered, bool sampleValid);
bool  isWallTooClose();
void  resetUltrasonicState();
bool  obstacleDetectedNow();

// parking
void startParkingSequence();
void parkingTick();

// special case helpers
inline void applyMatrixOverrideFor90TurnAtSpecialNodes();
void replanFromCurrentToGoal(bool doInititalMove);

// helper for line error
bool computeLineError(float &errorOut);

// helper for parking straight
static inline void DriveStraightTrim(int speed);

/* ===================== ROUTE COST ===================== */
static inline int edgeCost(int u, int v, int goal) {
  int c = 10;

  if (v == 0 || v == 2) c -= HUB_PREFERENCE_BONUS;
  if (v == 6 && goal != 6) c += NODE6_PENALTY_COST;

  if (u == 4 && v == 3) c += EDGE_4_TO_3_PENALTY_COST;

  if (c < 1) c = 1;
  return c;
}

/* ===================== LED helpers ===================== */
static inline void nodeLedOnPulse() {
  digitalWrite(NODE_LED_PIN, NODE_LED_ACTIVE_HIGH ? HIGH : LOW);
  nodeLedOffAt = millis() + NODE_LED_ON_MS;
}
static inline void nodeLedTick() {
  if (nodeLedOffAt && millis() > nodeLedOffAt) {
    digitalWrite(NODE_LED_PIN, NODE_LED_ACTIVE_HIGH ? LOW : HIGH);
    nodeLedOffAt = 0;
  }
}

/* ===================== WIFI / HTTP ===================== */
void connectToWiFi(uint32_t timeoutMs) {
  WiFi.mode(WIFI_STA);
  WiFi.setSleep(false);
  WiFi.disconnect(true, true);
  delay(150);

  WiFi.begin(WIFI_SSID, WIFI_PASSWORD);

  uint32_t start = millis();
  while (WiFi.status() != WL_CONNECTED && (millis() - start) < timeoutMs) {
    delay(150);
  }
}

bool ensureWiFi() {
  if (WiFi.status() == WL_CONNECTED) return true;
  connectToWiFi();
  return (WiFi.status() == WL_CONNECTED);
}

bool httpConnect() {
  if (!ensureWiFi()) return false;
  if (client.connected()) { client.stop(); delay(20); }
  return client.connect(API_HOST, API_PORT);
}

void httpStop() {
  if (client.connected()) { client.stop(); delay(20); }
}

String readHTTPResponse() {
  String response = "";
  uint32_t startTime = millis();
  while (millis() - startTime < HTTP_TIMEOUT_MS) {
    while (client.available()) response += (char)client.read();
    if (!client.connected() && response.length() > 0) break;
    delay(5);
  }
  return response;
}

String extractBody(const String& response) {
  int bodyStart = response.indexOf("\r\n\r\n");
  if (bodyStart == -1) return response;
  String body = response.substring(bodyStart + 4);
  body.trim();
  return body;
}

String apiPostArrived(int position) {
  if (!httpConnect()) return "";

  String postData = "position=" + String(position);

  String request = String("POST /api/arrived/") + TEAM_ID + " HTTP/1.1\r\n";
  request += "Host: " + String(API_HOST) + "\r\n";
  request += "Content-Type: application/x-www-form-urlencoded\r\n";
  request += "Content-Length: " + String(postData.length()) + "\r\n";
  request += "Connection: close\r\n\r\n";
  request += postData;

  client.print(request);
  client.flush();

  String body = extractBody(readHTTPResponse());
  httpStop();
  return body;
}

bool isFinishedMessage(String s) {
  s.trim();
  s.toLowerCase();
  return (s == "finished");
}

/* ===================== SETUP ===================== */
void setup() {
  Serial.begin(115200);
  delay(600);

  pinMode(MOTOR1_PWM, OUTPUT);
  pinMode(MOTOR1_PHASE, OUTPUT);
  pinMode(MOTOR2_PWM, OUTPUT);
  pinMode(MOTOR2_PHASE, OUTPUT);

  for (int i = 0; i < NUM_SENSORS; i++) pinMode(ANALOG_PIN[i], INPUT);

  digitalWrite(MOTOR1_PHASE, HIGH);
  digitalWrite(MOTOR2_PHASE, HIGH);

  pinMode(NODE_LED_PIN, OUTPUT);
  digitalWrite(NODE_LED_PIN, NODE_LED_ACTIVE_HIGH ? LOW : HIGH);

  // Ultrasonic disabled by default
  pinMode(US_TRIG_PIN, OUTPUT);
  pinMode(US_ECHO_PIN, INPUT);
  digitalWrite(US_TRIG_PIN, LOW);
  ultrasonicEnabled = false;

  connectToWiFi();
  if (WiFi.status() != WL_CONNECTED) {
    delay(1500);
    ESP.restart();
  }
  //servo initialisation
  leftServo.setPeriodHertz(50); // PWM frequency for SG90
  leftServo.attach(leftServoPin, 500, 2400); // Minimum and maximum pulse width (in µs) to go from 0° to 180
  rightServo.setPeriodHertz(50); // PWM frequency for SG90
  rightServo.attach(rightServoPin, 500, 2400); // Minimum and maximum pulse width (in µs) to go from 0° to 180

  //Display initialisation
  // Start I2C with chosen pins
  Wire.begin(SDA_PIN, SCL_PIN);

  // Initialize OLED
  if (!display.begin(SSD1306_SWITCHCAPVCC, 0x3C)) {
    Serial.println("OLED not found");
    while (true);
  }
  //music pin
  pinMode(musicPin, OUTPUT);
  digitalWrite(musicPin, HIGH);//set the music to start

  Serial.println("Robot Ready - Ultrasonic DISABLED (will activate only for parking)");
}

void tiltLeft() {
  leftServo.write(180);
  rightServo.write(180);
  delay(10);
}

void tiltRight() {
  leftServo.write(0);
  rightServo.write(0);
  delay(10);
}

void straighten() {
  leftServo.write(90);
  rightServo.write(90);
  delay(10);
}

void celebrate() {
  for (int i = 0; i < 5; i++) {

    leftServo.write(180);
    rightServo.write(0);
    delay(500);

    leftServo.write(0);
    rightServo.write(180);
    delay(500);

    tiltLeft();
    delay(500);

    tiltRight();
    delay(500);
  }
}

void servoTilt() {
  if (navigating == true) {
    switch(currentNode) {
      case 0:
        if (clockwise == true) {straighten();}
        else {tiltLeft();}
        break;
      case 1:
        straighten();
        break;
      case 2:
        if (clockwise == true) {tiltRight();}
        else {straighten();}
        break;
      case 3:
        if (clockwise == true) {straighten();}
        else {tiltLeft();}
        break;
      case 4:
        if (clockwise == true) {tiltRight();}
        else {straighten();}
        break;
      case 5:
        if (clockwise == true) {tiltRight();}
        else {tiltLeft();}
        break;
      case 6:
        if (clockwise == true) {tiltRight();}
        else {tiltLeft();}
        break;
    }
  }
}

#define OX 48   // x offset (move left/right)
#define OY 16   // y offset (move up/down)

// 'Screenshot_20260203_141424_WhatsApp', 128x64px
const unsigned char pikachu [] PROGMEM = {
	0xff, 0xff, 0xff, 0xff, 0xff, 0xf7, 0xff, 0xff, 0xff, 0xff, 0xff, 0xff, 0xff, 0xff, 0xff, 0xff, 
	0xff, 0xff, 0xff, 0xff, 0xff, 0xf3, 0xff, 0xff, 0xff, 0xff, 0xff, 0xff, 0xff, 0xff, 0xff, 0xff, 
	0xff, 0xff, 0xff, 0xff, 0xff, 0xe3, 0xff, 0xff, 0xff, 0xff, 0xff, 0xff, 0xff, 0xff, 0xff, 0xff, 
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	0xff, 0xff, 0xff, 0xff, 0xff, 0xff, 0xff, 0xff, 0xff, 0xbf, 0xff, 0xff, 0xff, 0xff, 0xff, 0xff
};

// '5209763456', 128x64px
const unsigned char pikass [] PROGMEM = {
	0xff, 0xff, 0xff, 0xff, 0xff, 0xff, 0xff, 0xff, 0xff, 0xff, 0xff, 0xff, 0xff, 0xff, 0xff, 0xff, 
	0xff, 0xff, 0xff, 0xff, 0xff, 0xff, 0xff, 0xff, 0xff, 0xff, 0xff, 0xff, 0xff, 0xff, 0xff, 0xff, 
	0xff, 0xff, 0xff, 0xff, 0xff, 0xff, 0xff, 0xff, 0xff, 0xff, 0xff, 0xff, 0xff, 0xff, 0xff, 0xff, 
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	0xff, 0xff, 0xff, 0xff, 0xff, 0xff, 0xff, 0xff, 0xff, 0xff, 0xff, 0xff, 0xff, 0xff, 0xff, 0xff
};

// '800px-0001Bulbasaur', 128x64px
const unsigned char bulbasaur [] PROGMEM = {
	0xff, 0xff, 0xff, 0xff, 0xff, 0xff, 0xff, 0xff, 0xff, 0xff, 0xff, 0xff, 0xff, 0xff, 0xff, 0xff, 
	0xff, 0xff, 0xff, 0xff, 0xff, 0xff, 0xff, 0xff, 0xff, 0xff, 0xff, 0xff, 0xff, 0xff, 0xff, 0xff, 
	0xff, 0xff, 0xff, 0xff, 0xff, 0xff, 0xff, 0xff, 0xff, 0xff, 0xff, 0xff, 0xff, 0xff, 0xff, 0xff, 
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	0xff, 0xff, 0xff, 0xff, 0xff, 0xff, 0xff, 0xff, 0xff, 0xff, 0xff, 0xff, 0xff, 0xff, 0xff, 0xff
};

// 'Charmander', 128x64px
const unsigned char charmander [] PROGMEM = {
	0xff, 0xff, 0xff, 0xff, 0xff, 0xff, 0xe3, 0xff, 0xff, 0xff, 0xff, 0xff, 0xff, 0xff, 0xff, 0xff, 
	0xff, 0xff, 0xff, 0xff, 0xff, 0xff, 0xdc, 0x7f, 0xff, 0xff, 0xff, 0xff, 0xff, 0xff, 0xff, 0xff, 
	0xff, 0xff, 0xff, 0xff, 0xff, 0xfd, 0xff, 0x9f, 0xff, 0xff, 0xff, 0xff, 0xff, 0xff, 0xff, 0xff, 
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	0xff, 0xff, 0xff, 0xff, 0xff, 0xff, 0xff, 0xff, 0xff, 0xff, 0xff, 0xff, 0xff, 0xff, 0xff, 0xff
};

// '007', 128x64px
const unsigned char squirtle  [] PROGMEM = {
	0xff, 0xff, 0xff, 0xff, 0xff, 0xff, 0xff, 0xff, 0xff, 0xff, 0xff, 0xff, 0xff, 0xff, 0xff, 0xff, 
	0xff, 0xff, 0xff, 0xff, 0xff, 0xff, 0xff, 0xff, 0xff, 0xff, 0xff, 0xff, 0xff, 0xff, 0xff, 0xff, 
	0xff, 0xff, 0xff, 0xff, 0xff, 0xff, 0xff, 0xff, 0xff, 0xff, 0xff, 0xff, 0xff, 0xff, 0xff, 0xff, 
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	0xff, 0xff, 0xff, 0xff, 0xff, 0xff, 0xff, 0xff, 0xff, 0xff, 0xff, 0xff, 0xff, 0xff, 0xff, 0xff
};

void drawSprite(int spriteNum) {
	switch(spriteNum) {
		case 0:
			display.clearDisplay();
  		display.drawBitmap(0, 0, squirtle, SCREEN_WIDTH, SCREEN_HEIGHT, WHITE);
			display.display();
			display.clearDisplay();
			break;
		case 1:
			display.clearDisplay();
			display.drawBitmap(0, 0, bulbasaur, SCREEN_WIDTH, SCREEN_HEIGHT, WHITE);
			display.display();
			display.clearDisplay();
			break;
		case 2:
			display.clearDisplay();
			display.drawBitmap(0, 0, charmander, SCREEN_WIDTH, SCREEN_HEIGHT, WHITE);
			display.display();
			display.clearDisplay();
			break;
		case 3:
			display.clearDisplay();
			display.drawBitmap(0, 0, pikachu, SCREEN_WIDTH, SCREEN_HEIGHT, WHITE);
			display.display();
			display.clearDisplay();
			break;
		case 4:
			display.clearDisplay();
			display.drawBitmap(0, 0, pikass, SCREEN_WIDTH, SCREEN_HEIGHT, WHITE);
			display.display();
			display.clearDisplay();
			break;
	}
}

void spriteLoop() {
  drawSprite(spriteNum);
  spriteNum++;
  if (spriteNum == 5) {
    spriteNum = 0;
  }
}
/* ===================== LOOP ===================== */
void loop() {
  if (finishedAll) { 
    motorStop(); 
    celebrate();
    return; 
  }

  const uint32_t now = millis();
  if (now - lastControlTick < CONTROL_TICK_MS) return;
  lastControlTick = now;

  //put goofy shit here!!!!!!!!!!!!!!!!!!!!!!!!!!!
  ReadSensorsFast();
  updateNodeDetector();
  servoTilt();

  // LED pulse on node detection (rising edge of stable)
  if (nodeStableNow && !nodeEventLatched) {
    nodeEventLatched = true;
    nodeLedOnPulse();
  }
  if (!nodeStableNow) nodeEventLatched = false;
  nodeLedTick();

  if (parkingStage != PARK_NONE && parkingStage != PARK_STOPPED) {
    parkingTick();
  } else if (parkingStage == PARK_STOPPED) {
    motorStop();
  } else {
    if (startingUp) {
      handleStartup();
    } else if (navigating) {

      // --- OBSTACLE CHECK (enabled) ---
      if (ENABLE_OBSTACLE_DETECTION &&
          parkingStage == PARK_NONE &&
          navigating &&
          millis() - lastObstacleCheckMs >= OBSTACLE_CHECK_MS) {

        lastObstacleCheckMs = millis();

        if (obstacleDetectedNow()) {

  Serial.println("*** OBSTACLE DETECTED - STOP + BLACKLIST EDGE + REROUTE ***");

  // 1️⃣ Immediate stop
  motorStop();
  delay(120);

  // 2️⃣ Back up slightly to clear obstacle and re-center on line
  digitalWrite(MOTOR1_PHASE, LOW);
  digitalWrite(MOTOR2_PHASE, LOW);
  analogWrite(MOTOR1_PWM, 160);
  analogWrite(MOTOR2_PWM, 160);
  delay(150);

  motorStop();
  delay(50);

  // 3️⃣ Now block the edge
  if (currentNode >= 0 && expectedNextNode >= 0 && expectedNextNode < NUM_NODES) {
    Serial.print("Blocking edge: ");
    Serial.print(currentNode);
    Serial.print(" <-> ");
    Serial.println(expectedNextNode);
    blockEdgeBothWays(currentNode, expectedNextNode);
  }

  navigating = false;
  pathComputed = false;

  nodeArmed = false;
  lastNodeTime = millis();

  // 4️⃣ Replan WITHOUT executing first move
  if (currentGoal >= 0 && currentGoal < NUM_NODES &&
      currentNode >= 0 && currentNode < NUM_NODES) {

    replanFromCurrentToGoal(false);

  } else {
    expectedNextNode = -1;
  }

  return;
}

      }

      lineFollowing(false);
      if (nodeArmed && nodeStableNow) handleNodeArrival();

    } else {
      motorStop();
    }
  }

  // Ask server only when stopped at goal and not parking
  if (!startingUp && !navigating && reachedGoalFlag && (parkingStage == PARK_NONE)) {
    reachedGoalFlag = false;

    String resp = apiPostArrived(currentNode);
    if (resp.length() == 0 || isFinishedMessage(resp)) {
      finishedAll = true;
      motorStop();
    } else {
      int nextNode = resp.toInt();
      if (nextNode == CMD_START_PARK) {
        startParkingSequence();
      } else {
        currentGoal = nextNode;
        navigateToTarget(currentGoal);
      }
    }
  }

  static uint32_t lastPrint = 0;
  if (now - lastPrint >= STATUS_PRINT_MS) {
    printCurrentStatus();
    lastPrint = now;
  }
}

/* ===================== STARTUP ===================== */
void handleStartup() {
  lineFollowing(false);

  if (nodeArmed && nodeStableNow) {
    motorStop();
    delay(120);

    currentNode = 0;
    startingUp = false;
    expectedNextNode = -1;

    reachedGoalFlag = true;
    nodeArmed = false;
    lastNodeTime = millis();
  }
}

/* ===================== NODE ARRIVAL ===================== */
void handleNodeArrival() {
  motorStop();
  spriteLoop();
  delay(90);

  if (!pathComputed || !navigating) return;
  if (pathStep >= pathLength) {
    navigating = false;
    pathComputed = false;
    expectedNextNode = -1;
    return;
  }

  currentNode = path[pathStep];

  // Special case from your code
  if (pathStep > 0) {
    int prevNode = path[pathStep - 1];
    if (prevNode == 1 && (currentNode == 5 || currentNode == 6) && currentNode != currentGoal) {
      delay(40);
      turn90Left();
      clockwise = false; // force anti-clockwise
      replanFromCurrentToGoal(true);

      nodeArmed = false;
      lastNodeTime = millis();
      return;
    }
  }

  if (currentNode == currentGoal) {
    navigating = false;
    pathComputed = false;
    expectedNextNode = -1;

    nodeArmed = false;
    lastNodeTime = millis();

    // Parking leg 1 complete: reached node 1 -> go to node 6
    if (parkingStage == PARK_GOTO_NODE1 && currentGoal == PARK_START_NODE) {
      parkingStage = PARK_GOTO_NODE6;
      currentGoal  = PARK_INTERMEDIATE_NODE;   // 6
      navigateToTarget(currentGoal);

      nodeArmed = false;
      lastNodeTime = millis();
      return;
    }

    // Parking leg 2 complete: reached node 6 -> drive straight to wall
    if (parkingStage == PARK_GOTO_NODE6 && currentGoal == PARK_INTERMEDIATE_NODE) {
      motorStop();
      delay(80);

      parkingStage = PARK_DRIVE_STRAIGHT_TO_WALL;
      resetUltrasonicState();   // ultrasonic remains enabled

      return;
    }

    reachedGoalFlag = true;
    return;
  }

  if (pathStep >= pathLength - 1) {
    navigating = false;
    pathComputed = false;
    expectedNextNode = -1;
    return;
  }

  int from = path[pathStep];
  int to   = path[pathStep + 1];
  int movement = movementForEdge(from, to);

  pathStep++;
  executeMovement(movement, to);

  nodeArmed = false;
  lastNodeTime = millis();
}

/* ===================== PARKING ===================== */
void startParkingSequence() {
  Serial.println("=== PARKING SEQUENCE STARTED - ULTRASONIC ENABLED ===");
  enableUltrasonic();
  parkingWallReported = false;

  // If parking is triggered while we are already at node 1,
  // skip the "go to node 1" leg and go straight to node 6.
  if (currentNode == PARK_START_NODE) {
    Serial.println("Parking: already at node 1 -> skipping GOTO_NODE1, going straight to node 6");

    motorStop();
    delay(120);  // small settle so we don't launch while sitting on the node

    parkingStage = PARK_GOTO_NODE6;
    currentGoal  = PARK_INTERMEDIATE_NODE;   // 6
    navigateToTarget(currentGoal);

    nodeArmed = false;
    lastNodeTime = millis();
    return;
  }

  // Normal parking flow: go to node 1 first
  parkingStage = PARK_GOTO_NODE1;
  currentGoal  = PARK_START_NODE;            // 1
  navigateToTarget(currentGoal);

  nodeArmed = false;
  lastNodeTime = millis();
}


void parkingTick() {
  const uint32_t now = millis();

  switch (parkingStage) {
    case PARK_GOTO_NODE1:
    case PARK_GOTO_NODE6: {
      if (navigating) {
        lineFollowing(false);
        if (nodeArmed && nodeStableNow) handleNodeArrival();
      }
    } break;

    case PARK_DRIVE_STRAIGHT_TO_WALL: {
      // No line following here—just straight drive until wall is confirmed
      if (isWallTooClose()) {
        Serial.println("*** WALL DETECTED - PARKING COMPLETE (report node 5) ***");
        motorStop();
        parkingStage = PARK_STOPPED;
        reachedGoalFlag = false;

        if (!parkingWallReported) {
          parkingWallReported = true;
          String resp = apiPostArrived(PARK_WALL_HIT_NODE);
          (void)resp;
        }

        disableUltrasonic(); // parking complete
        celebrate();
        break;
      }

      DriveStraightTrim(PARK_BASE_SPEED);
      lastCorrection = 0.0f;
    } break;

    case PARK_STRAIGHT_ON_LINE: {
      lineFollowing(true);
      if (now - parkStraightStartMs >= PARK_TO_STRAIGHT_MS) {
        parkingStage = PARK_UNTIL_LINE_LOST;
        lineLostSinceMs = 0;
      }
    } break;

    case PARK_UNTIL_LINE_LOST: {
      lineFollowing(true);

      if (!isLinePresent()) {
        if (lineLostSinceMs == 0) lineLostSinceMs = now;
        if (now - lineLostSinceMs >= PARK_LINE_LOST_MS) {
          parkingStage = PARK_BEND_AWAY_IF_LINE_REAPPEARS;
          resetUltrasonicState();
        }
      } else {
        lineLostSinceMs = 0;
      }
    } break;

    case PARK_BEND_AWAY_IF_LINE_REAPPEARS: {
      if (isWallTooClose()) {
        Serial.println("*** WALL DETECTED - PARKING COMPLETE (report node 5) ***");
        motorStop();
        parkingStage = PARK_STOPPED;
        reachedGoalFlag = false;

        if (!parkingWallReported) {
          parkingWallReported = true;
          String resp = apiPostArrived(PARK_WALL_HIT_NODE);
          (void)resp;
        }

        disableUltrasonic();
        break;
      }

      DriveStraightTrim(PARK_BASE_SPEED);
      lastCorrection = 0.0f;
    } break;

    default: break;
  }
}

/* ===================== ULTRASONIC ===================== */
void enableUltrasonic() {
  ultrasonicEnabled = true;
  resetUltrasonicState();
  Serial.println("ULTRASONIC ENABLED - Parking mode");
}

void disableUltrasonic() {
  ultrasonicEnabled = false;
  usEma = 0.0f;
  wallHitCount = 0;
  wallConfirmed = false;

  // also reset obstacle counters to avoid stale state if you re-enable later
  obstacleHitCount = 0;
  obstacleDetected = false;

  digitalWrite(US_TRIG_PIN, LOW);
  Serial.println("ULTRASONIC DISABLED - Normal navigation");
}

void resetUltrasonicState() {
  lastUSms = 0;
  usEma = 0.0f;
  wallHitCount = 0;
  wallInvalidStreak = 0;
  wallConfirmed = false;
}

float ultrasonicMeasureOnceCm() {
  if (!ultrasonicEnabled) return 999.0f;

  digitalWrite(US_TRIG_PIN, LOW);
  delayMicroseconds(2);
  digitalWrite(US_TRIG_PIN, HIGH);
  delayMicroseconds(10);
  digitalWrite(US_TRIG_PIN, LOW);

  uint32_t duration = pulseIn(US_ECHO_PIN, HIGH, US_TIMEOUT_US);
  if (duration == 0) return 0.0f;

  float distance_cm = (duration * SOUND_SPEED_CM_PER_US) / 2.0f;

  if (distance_cm < US_HARD_MIN_CM) distance_cm = US_HARD_MIN_CM;
  if (distance_cm > US_TIMEOUT_CM)  distance_cm = US_TIMEOUT_CM;

  return distance_cm;
}

float ultrasonicFilteredCm(bool forceSample) {
  if (!ultrasonicEnabled) return 999.0f;

  const uint32_t now = millis();

  if (forceSample || (now - lastUSms >= US_PERIOD_MS)) {
    lastUSms = now;

    float samples[US_SAMPLES];
    uint8_t validSamples = 0;

    for (uint8_t i = 0; i < US_SAMPLES; i++) {
      float cm = ultrasonicMeasureOnceCm();
      if (cm > 0) samples[validSamples++] = cm;
      delayMicroseconds(US_SAMPLE_GAP_US);
    }

    if (validSamples >= 3) {
      // sort
      for (uint8_t i = 0; i < validSamples - 1; i++) {
        for (uint8_t j = i + 1; j < validSamples; j++) {
          if (samples[i] > samples[j]) {
            float t = samples[i];
            samples[i] = samples[j];
            samples[j] = t;
          }
        }
      }

      uint8_t startIdx = US_DISCARD;
      uint8_t endIdx   = validSamples - US_DISCARD;
      if (startIdx >= endIdx) { startIdx = 0; endIdx = validSamples; }

      float sum = 0;
      uint8_t cnt = 0;
      for (uint8_t i = startIdx; i < endIdx; i++) { sum += samples[i]; cnt++; }

      float trimmedMean = (cnt > 0) ? (sum / cnt) : 0.0f;

      if (usEma <= 0) usEma = trimmedMean;
      else usEma = US_EMA_ALPHA * trimmedMean + (1.0f - US_EMA_ALPHA) * usEma;
    }

    wallDetectUpdate(usEma, (validSamples >= 3));
  }

  return usEma;
}

void wallDetectUpdate(float cmFiltered, bool sampleValid) {
  if (!ultrasonicEnabled) return;

  if (sampleValid && cmFiltered > 0) {
    wallInvalidStreak = 0;
    if (cmFiltered <= WALL_STOP_DISTANCE_CM) {
      if (wallHitCount < 255) wallHitCount++;
    } else {
      if (wallHitCount > 0) wallHitCount--;
    }
  } else {
    if (wallInvalidStreak < 255) wallInvalidStreak++;
    if (wallInvalidStreak > WALL_GRACE_INVALID) {
      if (wallHitCount > 0) wallHitCount--;
    }
  }
  wallConfirmed = (wallHitCount >= WALL_CONFIRM_HITS);
}

bool isWallTooClose() {
  if (!ultrasonicEnabled) return false;
  ultrasonicFilteredCm(true);
  return wallConfirmed;
}

bool obstacleDetectedNow() {
  if (!ultrasonicEnabled) return false;

  float cm = ultrasonicFilteredCm(false);

  if (cm > 0 && cm < OBSTACLE_MAX_VALID_CM && cm <= OBSTACLE_STOP_DISTANCE_CM) {

    if (obstacleHitCount < 255) obstacleHitCount++;
  } else {
    if (obstacleHitCount > 0) obstacleHitCount--;
  }

  obstacleDetected = (obstacleHitCount >= OBSTACLE_CONFIRM_HITS);
  return obstacleDetected;
}

/* ===================== SPECIAL CASE HELPERS ===================== */
inline void applyMatrixOverrideFor90TurnAtSpecialNodes() {
  if (currentNode == 5) clockwise = false;
  else if (currentNode == 6) clockwise = true;
}

void replanFromCurrentToGoal(bool doInitialMove) {
  if (currentNode < 0 || currentNode >= NUM_NODES) { navigating=false; pathComputed=false; expectedNextNode=-1; motorStop(); return; }
  if (currentGoal < 0 || currentGoal >= NUM_NODES) { navigating=false; pathComputed=false; expectedNextNode=-1; motorStop(); return; }

  if (!dijkstraPathfinding(currentNode, currentGoal)) { navigating=false; pathComputed=false; expectedNextNode=-1; motorStop(); return; }

  pathComputed = true;
  navigating = true;

  // IMPORTANT: after replan, the "next node to reach" is path[1]
  if (pathLength > 1) {
    pathStep = 1;
    expectedNextNode = path[1];
  } else {
    pathStep = 0;
    expectedNextNode = -1;
  }

  if (doInitialMove && pathLength > 1 && currentNode == path[0]) {
    int firstMove = movementForEdge(path[0], path[1]);
    executeMovement(firstMove, path[1]);
    nodeArmed = false;
    lastNodeTime = millis();
  }
}


/* ===================== PATHFINDING ===================== */
int movementForEdge(int from, int to) {
  int mCw  = clockwiseMatrix[from][to];
  int mAcw = antiClockwiseMatrix[from][to];

  // Prefer current orientation if valid
  if (clockwise && mCw != 0) return mCw;
  if (!clockwise && mAcw != 0) return mAcw;

  // Otherwise switch to whichever matrix supports this edge
  if (mCw != 0)  { clockwise = true;  return mCw; }
  if (mAcw != 0) { clockwise = false; return mAcw; }

  return 0; // truly no edge
}


bool dijkstraPathfinding(int startIdx, int endIdx) {
  pathLength = 0;
  pathStep = 0;

  int dist[NUM_NODES];
  int prev[NUM_NODES];
  bool visited[NUM_NODES];

  for (int i = 0; i < NUM_NODES; i++) {
    dist[i] = 999999;
    prev[i] = -1;
    visited[i] = false;
  }
  dist[startIdx] = 0;

  for (int count = 0; count < NUM_NODES; count++) {
    int minDist = 999999;
    int u = -1;

    for (int v = 0; v < NUM_NODES; v++) {
      if (!visited[v] && dist[v] < minDist) { minDist = dist[v]; u = v; }
    }
    if (u == -1 || u == endIdx) break;
    visited[u] = true;

    for (int v = 0; v < NUM_NODES; v++) {
      bool edgeExists = ((antiClockwiseMatrix[u][v] != 0) || (clockwiseMatrix[u][v] != 0));
      if (edgeExists && !isEdgeBlocked(u, v)) {

        int newDist = dist[u] + edgeCost(u, v, endIdx);
        if (newDist < dist[v]) { dist[v] = newDist; prev[v] = u; }
      }
    }
  }

  if (dist[endIdx] == 999999) return false;

  int cur = endIdx;
  while (cur != -1) { path[pathLength++] = cur; cur = prev[cur]; }

  for (int i = 0; i < pathLength / 2; i++) {
    int t = path[i];
    path[i] = path[pathLength - 1 - i];
    path[pathLength - 1 - i] = t;
  }
  return true;
}

void navigateToTarget(int targetNode) {
  if (!ultrasonicEnabled) enableUltrasonic();
  if (currentNode < 0 || currentNode >= NUM_NODES) { navigating = false; pathComputed = false; expectedNextNode = -1; motorStop(); return; }
  if (!dijkstraPathfinding(currentNode, targetNode)) { navigating = false; pathComputed = false; expectedNextNode = -1; motorStop(); return; }

  pathComputed = true;
  navigating = true;

  if (pathLength > 1 && currentNode == path[0]) {
    int firstMove = movementForEdge(path[0], path[1]);
    pathStep = 1;
    executeMovement(firstMove, path[1]);
    nodeArmed = false;
    lastNodeTime = millis();
  } else {
    pathStep = 0;
  }
}

/* ===================== SENSORS / NODE DETECTION ===================== */
void ReadSensorsFast() {
  for (int i = 0; i < NUM_SENSORS; i++) analogValue[i] = analogRead(ANALOG_PIN[i]);
}

uint8_t countLowSensors() {
  uint8_t low = 0;
  for (int i = 0; i < NUM_SENSORS; i++) if (analogValue[i] < LINE_THRESHOLD) low++;
  return low;
}

bool isLinePresent() { return (countLowSensors() >= 1); }

int lineMinIndex() {
  int minIndex = 0;
  int minValue = analogValue[0];
  for (int i = 1; i < NUM_SENSORS; i++) {
    if (analogValue[i] < minValue) { minValue = analogValue[i]; minIndex = i; }
  }
  return minIndex;
}

// weak/relaxed node detection ONLY when going to node 6 (expectedNextNode == 6)
bool isNodeNowFast() {
  const bool approaching6 = (expectedNextNode == 6);

  // Precompute low flags
  bool low[NUM_SENSORS];
  uint8_t lowCnt = 0;
  for (int i = 0; i < NUM_SENSORS; i++) {
    low[i] = (analogValue[i] < LINE_THRESHOLD);
    if (low[i]) lowCnt++;
  }

  // Normal node rule (all other nodes)
  if (!approaching6) {
    return (lowCnt >= NODE_TRIP_LOWCOUNT_STRONG); // 4
  }

  // --- Node 6 special rule: 3 consecutive lows from an edge ---
  const bool leftEdgeTriple  = low[0] && low[1] && low[2];
  const bool rightEdgeTriple = low[2] && low[3] && low[4];

  // --- Extra sensitive only during parking leg node1->node6 ---
  if (node6ExtraSensitiveActive()) {
    // 2 consecutive from an edge (more sensitive)
    if (node6ExtraSensitiveActive()) {
  return (lowCnt >= 2);
}

  }

  // Normal (non-parking) approach to node 6
  return (leftEdgeTriple || rightEdgeTriple);
}



void updateNodeDetector() {
  const uint32_t now = millis();
  bool nodeNow = isNodeNowFast();

  uint32_t debounce = NODE_DEBOUNCE_MS;

if (expectedNextNode == 6) {
  debounce = node6ExtraSensitiveActive() ? NODE6_DEBOUNCE_MS_PARK : NODE6_DEBOUNCE_MS_NORMAL;
}


  if (!nodeArmed) {
    if ((now - lastNodeTime) >= NODE_REARM_MS) {
      if (!nodeNow) nodeArmed = true;
    }
  }

  if (nodeNow) {
    if (nodeHighSince == 0) nodeHighSince = now;
    if ((now - nodeHighSince) >= debounce) nodeStableNow = true;
  } else {
    nodeHighSince = 0;
    nodeStableNow = false;
  }
}

/* ===================== MOTOR CONTROL ===================== */
void SetMotors(int leftSpeed, int rightSpeed) {
  rightSpeed += MOTOR2_OFFSET_PWM;

  leftSpeed  = (int)((float)leftSpeed  * LEFT_MOTOR_GAIN);
  rightSpeed = (int)((float)rightSpeed * RIGHT_MOTOR_GAIN);

  leftSpeed  = constrain(leftSpeed, MIN_SPEED, MAX_SPEED);
  rightSpeed = constrain(rightSpeed, MIN_SPEED, MAX_SPEED);

  analogWrite(MOTOR1_PWM, leftSpeed);
  analogWrite(MOTOR2_PWM, rightSpeed);

  digitalWrite(MOTOR1_PHASE, HIGH);
  digitalWrite(MOTOR2_PHASE, HIGH);
}

void motorStop() {
  analogWrite(MOTOR1_PWM, 0);
  analogWrite(MOTOR2_PWM, 0);
}

// Parking-only: drive straight using your proven TRIM logic.
// This does NOT use MOTOR2_OFFSET_PWM or LEFT/RIGHT gains.
static inline void DriveStraightTrim(int speed) {
  int leftSpeed  = constrain(speed, MIN_SPEED, MAX_SPEED);
  int rightSpeed = constrain(speed + PARK_TRIM, MIN_SPEED, MAX_SPEED);

  digitalWrite(MOTOR1_PHASE, HIGH);
  digitalWrite(MOTOR2_PHASE, HIGH);

  analogWrite(MOTOR1_PWM, leftSpeed);
  analogWrite(MOTOR2_PWM, rightSpeed);
}

/* ===================== TURNS ===================== */
void turn180() {
  const float scale = (currentNode == 6) ? TURN180_SCALE_NODE6 : TURN180_SCALE_NORMAL;

  digitalWrite(MOTOR1_PHASE, LOW);
  digitalWrite(MOTOR2_PHASE, HIGH);
  analogWrite(MOTOR1_PWM, BASE_SPEED);
  analogWrite(MOTOR2_PWM, BASE_SPEED);
  delay((uint32_t)((float)TURN180_MS_BASE * scale));
  motorStop();
}

void turn90Left() {
  digitalWrite(MOTOR1_PHASE, HIGH);
  digitalWrite(MOTOR2_PHASE, HIGH);
  analogWrite(MOTOR1_PWM, BASE_SPEED);
  analogWrite(MOTOR2_PWM, BASE_SPEED);
  delay(TURN_PRE_FORWARD_MS);
  motorStop();
  delay(TURN_PRE_PAUSE_MS);

  digitalWrite(MOTOR1_PHASE, HIGH);
  digitalWrite(MOTOR2_PHASE, LOW);
  analogWrite(MOTOR1_PWM, BASE_SPEED);
  analogWrite(MOTOR2_PWM, BASE_SPEED);
  delay(TURN90_MS);
  motorStop();
}

void turn90Right() {
  digitalWrite(MOTOR1_PHASE, HIGH);
  digitalWrite(MOTOR2_PHASE, HIGH);
  analogWrite(MOTOR1_PWM, BASE_SPEED);
  analogWrite(MOTOR2_PWM, BASE_SPEED);
  delay(TURN_PRE_FORWARD_MS);
  motorStop();
  delay(TURN_PRE_PAUSE_MS);

  digitalWrite(MOTOR1_PHASE, LOW);
  digitalWrite(MOTOR2_PHASE, HIGH);
  analogWrite(MOTOR1_PWM, BASE_SPEED);
  analogWrite(MOTOR2_PWM, BASE_SPEED);
  delay(TURN90_MS);
  motorStop();
}
static inline void turn180ThenBackoff() {
  // 1) Turn 180 normally (your calibrated routine)
  turn180();

  // 2) Reverse a little AFTER the 180 (to clear the node / land on the segment)
  int pwm = constrain(PARK_NODE1_POST180_BACKOFF_PWM, MIN_SPEED, MAX_SPEED);

  digitalWrite(MOTOR1_PHASE, LOW);
  digitalWrite(MOTOR2_PHASE, LOW);
  analogWrite(MOTOR1_PWM, pwm);
  analogWrite(MOTOR2_PWM, pwm);
  delay(PARK_NODE1_POST180_BACKOFF_MS);

  motorStop();
  delay(PARK_NODE1_POST180_PAUSE_MS);

  // Restore forward phase for line following
  digitalWrite(MOTOR1_PHASE, HIGH);
  digitalWrite(MOTOR2_PHASE, HIGH);
}


/* ===================== CATCH LINE AFTER TURN ===================== */
void catchLineAfterTurn(int biasDir) {
  uint32_t start = millis();

  while (millis() - start < CATCHLINE_TIMEOUT_MS) {
    ReadSensorsFast();

    bool centerOk = (analogValue[2] < LINE_THRESHOLD) ||
                    (analogValue[1] < LINE_THRESHOLD) ||
                    (analogValue[3] < LINE_THRESHOLD);

    if (centerOk) {
      motorStop();
      delay(20);
      return;
    }

    int left  = CATCHLINE_SPEED - biasDir * CATCHLINE_SPIN_DELTA;
    int right = CATCHLINE_SPEED + biasDir * CATCHLINE_SPIN_DELTA;
    SetMotors(left, right);
    delay(10);
  }

  motorStop();
  delay(20);
}

/* ===================== MOVEMENT EXECUTION ===================== */
void executeMovement(int movementType, int nextNode) {
  expectedNextNode = nextNode;

  motorStop();
  delay(MOVE_PRESTOP_MS);

  switch (movementType) {
    case 1:
      digitalWrite(MOTOR1_PHASE, HIGH);
      digitalWrite(MOTOR2_PHASE, HIGH);
      analogWrite(MOTOR1_PWM, BASE_SPEED);
      analogWrite(MOTOR2_PWM, BASE_SPEED);
      delay(MOVE_EXIT_NODE_MS);
      motorStop();
      delay(MOVE_PAUSE_MS);
      break;

    case -1: {
  const bool parkingNode1To6 =
      (parkingStage == PARK_GOTO_NODE6) &&
      (currentNode == PARK_START_NODE) &&
      (nextNode == PARK_INTERMEDIATE_NODE);

  if (parkingNode1To6) {
    turn180ThenBackoff();
  } else {
    turn180();
  }

  clockwise = !clockwise;

  // Exit node forward as usual so lineFollowing can take over cleanly
  digitalWrite(MOTOR1_PHASE, HIGH);
  digitalWrite(MOTOR2_PHASE, HIGH);
  analogWrite(MOTOR1_PWM, BASE_SPEED);
  analogWrite(MOTOR2_PWM, BASE_SPEED);
  delay(MOVE_EXIT_NODE_MS);
  motorStop();
  delay(MOVE_PAUSE_MS);
} break;


    case 2:
      applyMatrixOverrideFor90TurnAtSpecialNodes();
      turn90Left();
      catchLineAfterTurn(-1);
      digitalWrite(MOTOR1_PHASE, HIGH);
      digitalWrite(MOTOR2_PHASE, HIGH);
      analogWrite(MOTOR1_PWM, BASE_SPEED);
      analogWrite(MOTOR2_PWM, BASE_SPEED);
      delay(MOVE_EXIT_NODE_MS);
      motorStop();
      delay(MOVE_PAUSE_MS);
      break;

    case 3:
      applyMatrixOverrideFor90TurnAtSpecialNodes();
      turn90Right();
      catchLineAfterTurn(+1);
      digitalWrite(MOTOR1_PHASE, HIGH);
      digitalWrite(MOTOR2_PHASE, HIGH);
      analogWrite(MOTOR1_PWM, BASE_SPEED);
      analogWrite(MOTOR2_PWM, BASE_SPEED);
      delay(MOVE_EXIT_NODE_MS);
      motorStop();
      delay(MOVE_PAUSE_MS);
      break;

    default:
      motorStop();
      delay(120);
      break;
  }

  nodeArmed = false;
  lastNodeTime = millis();
}

/* ===================== LINE FOLLOWING ===================== */
static const int8_t SENSOR_WEIGHT[NUM_SENSORS] = {-2, -1, 0, 1, 2};

bool computeLineError(float &errorOut) {
  long weightedSum = 0;
  int  seenCount   = 0;

  for (int i = 0; i < NUM_SENSORS; i++) {
    if (analogValue[i] < LINE_THRESHOLD) {
      weightedSum += SENSOR_WEIGHT[i];
      seenCount++;
    }
  }

  if (seenCount == 0) return false;
  errorOut = (float)weightedSum / (float)seenCount;
  return true;
}

void lineFollowing(bool straightBias) {
  float error = 0.0f;
  bool lineOk = computeLineError(error);

  if (!lineOk) {
    int dir = (lastError < 0) ? -1 : 1;

    int leftSpeed  = BASE_SPEED - dir * 140;
    int rightSpeed = BASE_SPEED + dir * 140;

    leftSpeed  = constrain(leftSpeed,  MIN_SPEED, MAX_SPEED);
    rightSpeed = constrain(rightSpeed, MIN_SPEED, MAX_SPEED);

    SetMotors(leftSpeed, rightSpeed);
    lastCorrection = (float)(rightSpeed - leftSpeed);
    return;
  }

  float dErr = error - lastError;
  float correction = KP * error + KD * dErr;
  lastError = error;

  correction *= CORRECTION_SCALE_NORMAL;
  if (straightBias) correction *= CORRECTION_SCALE_PARK;

  correction = constrain(correction, -MAX_CORRECTION, MAX_CORRECTION);
  lastCorrection = correction;

  int leftSpeed  = (int)((float)BASE_SPEED - correction);
  int rightSpeed = (int)((float)BASE_SPEED + correction);

  leftSpeed  = constrain(leftSpeed,  MIN_SPEED, MAX_SPEED);
  rightSpeed = constrain(rightSpeed, MIN_SPEED, MAX_SPEED);

  SetMotors(leftSpeed, rightSpeed);
}

/* ===================== STATUS ===================== */
void printCurrentStatus() {
  Serial.println("\n=== STATUS ===");
  Serial.print("node="); Serial.print(currentNode);
  Serial.print(" goal="); Serial.print(currentGoal);
  Serial.print(" expNext="); Serial.print(expectedNextNode);
  Serial.print(" parkingStage="); Serial.println((int)parkingStage);
  Serial.print(" ultrasonicEnabled="); Serial.println(ultrasonicEnabled ? "YES" : "NO");

  Serial.print("minIdx="); Serial.print(lineMinIndex());
  Serial.print(" lowCnt="); Serial.print((int)countLowSensors());
  Serial.print(" corr="); Serial.println(lastCorrection, 1);

  if (ultrasonicEnabled) {
    Serial.print("US_cm="); Serial.print(usEma, 2);
    Serial.print(" hit="); Serial.print(wallHitCount);
    Serial.print(" inv="); Serial.print(wallInvalidStreak);
    Serial.print(" conf="); Serial.println(wallConfirmed ? "Y" : "N");
  }
}

